## package/libxkbcommon/Config.in
```kconfig
config BR2_PACKAGE_LIBXKBCOMMON
	bool "libxkbcommon"
	select BR2_PACKAGE_LIBXCB if BR2_PACKAGE_XORG7
	select BR2_PACKAGE_WAYLAND_PROTOCOLS if BR2_PACKAGE_WAYLAND
	help
	  xkbcommon is a keymap compiler and support library which
	  processes a reduced subset of keymaps as defined by the XKB
	  specification.

	  https://xkbcommon.org
```
